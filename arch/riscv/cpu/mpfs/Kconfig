## arch/riscv/cpu/mpfs/Kconfig
```kconfig
config MICROCHIP_MPFS # dummy
	def_bool y
	select GENERIC_RISCV
	select BOARD_EARLY_INIT_F
	select BOARD_LATE_INIT
	imply SMP
	imply CLK_CCF
	imply CLK_MPFS
	imply SYS_NS16550
	imply MACB
	imply MII
	imply MMC
	imply MMC_WRITE
	imply MMC_SDHCI
	imply MMC_SDHCI_CADENCE
	imply MMC_SDHCI_ADMA
	imply MMC_HS200_SUPPORT
	imply DM_I2C
	imply SYS_I2C_MICROCHIP
	imply SPI
	imply DM_SPI
	imply MICROCHIP_COREQSPI
```

## board/microchip/mpfs_icicle/Kconfig
```kconfig
if TARGET_MICROCHIP_ICICLE

config SYS_BOARD
	default "mpfs_icicle"

config SYS_VENDOR
	default "microchip"

config SYS_CPU
	default "generic"

config SYS_CONFIG_NAME
	default "microchip_mpfs_icicle"

config SYS_TEXT_BASE
	default 0x80000000 if !RISCV_SMODE
	default 0x80200000 if RISCV_SMODE

config BOARD_SPECIFIC_OPTIONS # dummy
	def_bool y
	select MICROCHIP_MPFS
	imply CMD_DHCP
	imply CMD_EXT2
	imply CMD_EXT4
	imply CMD_FAT
	imply CMD_FS_GENERIC
	imply CMD_NET
	imply CMD_PING
	imply CMD_MMC
	imply DOS_PARTITION
	imply EFI_PARTITION
	imply IP_DYN
	imply ISO_PARTITION
	imply PHY_LIB
	imply PHY_VITESSE
	imply CMD_I2C
	imply DM_I2C
	imply MTD_SPI_NAND
	imply CMD_MTD
	imply MTD_PARTITIONS
	imply CMD_MTDPARTS

endif
```

## board/microchip/mpfs_vauban/Kconfig
```kconfig
if TARGET_MICROCHIP_VAUBAN

config SYS_BOARD
	default "mpfs_vauban"

config SYS_VENDOR
	default "microchip"

config SYS_CPU
	default "mpfs"

config SYS_CONFIG_NAME
	default "microchip_mpfs_vauban"

config SYS_TEXT_BASE
	default 0x1000000000 if !RISCV_SMODE
	default 0x1000200000 if RISCV_SMODE

config BOARD_SPECIFIC_OPTIONS # dummy
	def_bool y
	select MICROCHIP_MPFS
	select BOARD_EARLY_INIT_F
	select BOARD_LATE_INIT
	imply CMD_DHCP
	imply CMD_EXT2
	imply CMD_EXT4
	imply CMD_FAT
	imply CMD_FS_GENERIC
	imply CMD_NET
	imply CMD_PING
	imply CMD_MMC
	imply DOS_PARTITION
	imply EFI_PARTITION
	imply IP_DYN
	imply ISO_PARTITION
	imply PHY_LIB
	imply PHY_VITESSE
	imply CMD_I2C
	imply DM_I2C
	imply MTD_SPI_NAND
	imply CMD_MTD
	imply MTD_PARTITIONS
	imply CMD_MTDPARTS

endif
```

## configs/microchip_mpfs_vauban_defconfig
```kconfig
CONFIG_RISCV=y
CONFIG_SYS_MALLOC_LEN=0x800000
CONFIG_SYS_MALLOC_F_LEN=0x2000
CONFIG_ENV_SIZE=0x2000
CONFIG_DEFAULT_DEVICE_TREE="mpfs-vauban"
CONFIG_SYS_PROMPT="RISC-V # "
CONFIG_TARGET_MICROCHIP_VAUBAN=y
CONFIG_ARCH_RV64I=y
CONFIG_RISCV_SMODE=y
CONFIG_DISTRO_DEFAULTS=y
CONFIG_SYS_LOAD_ADDR=0x1000200000
CONFIG_FIT=y
CONFIG_DISPLAY_CPUINFO=y
CONFIG_DISPLAY_BOARDINFO=y
CONFIG_SYS_CBSIZE=256
CONFIG_SYS_PBSIZE=282
CONFIG_SYS_BOOTM_LEN=0x4000000
CONFIG_SYS_MEM_TOP_HIDE=0x400000
CONFIG_SYS_RELOC_GD_ENV_ADDR=y
CONFIG_BOOTP_SEND_HOSTNAME=y
CONFIG_DM_MTD=y
CONFIG_BOOTCOMMAND="setenv fileaddr 0x90000000; setenv autoload no; dhcp; setenv serverip 192.168.2.5; tftp ${fileaddr} vauban-boot.scr; source ${fileaddr};"
CONFIG_USE_BOOTCOMMAND=y
```
